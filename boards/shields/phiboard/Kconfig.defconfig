## boards/shields/phiboard/Kconfig.defconfig
```kconfig
if SHIELD_PHIBOARD_LEFT

config ZMK_KEYBOARD_NAME
    default "phiboard"

config ZMK_SPLIT_ROLE_CENTRAL
    default y

endif # SHIELD_PHIBOARD_LEFT

if SHIELD_PHIBOARD_LEFT || SHIELD_PHIBOARD_RIGHT

config ZMK_SPLIT
    default y

endif # SHIELD_PHIBOARD_LEFT || SHIELD_PHIBOARD_RIGHT
```

## firmware/zmk-config/boards/shields/goose/Kconfig.defconfig
```kconfig
if SHIELD_GOOSE_LEFT

config ZMK_KEYBOARD_NAME
    default "phiboard v1"
config USB_DEVICE_MANUFACTURER
    default "phiwan"
config ZMK_SPLIT_ROLE_CENTRAL
    default y

endif

if SHIELD_GOOSE_LEFT || SHIELD_GOOSE_RIGHT

config ZMK_SPLIT
    default y
endif
```

## firmware/zmk-config/boards/shields/goose/Kconfig.shield
```kconfig
config SHIELD_PHIBOARD_LEFT
    def_bool $(shields_list_contains,phiboard_left)

config SHIELD_PHIBOARD_RIGHT
    def_bool $(shields_list_contains,phiboard_right)
```

## firmware/zmk-config/boards/shields/phiboard/Kconfig.defconfig
```kconfig
if SHIELD_PHIBOARD_RIGHT

# Name must be less than 16 characters long!
config ZMK_KEYBOARD_NAME
    default "phiboard"
config USB_DEVICE_MANUFACTURER
    default "phiwan"
config ZMK_SPLIT_ROLE_CENTRAL
    default y

config ZMK_DISPLAY
    default y

endif

# for Debugging purposes, should never advertise itself
if SHIELD_PHIBOARD_LEFT

config ZMK_KEYBOARD_NAME
    default "phiboard slave"

config ZMK_DISPLAY
    default y

endif

if SHIELD_PHIBOARD_LEFT || SHIELD_PHIBOARD_RIGHT

config ZMK_SPLIT
    default y

endif
```
